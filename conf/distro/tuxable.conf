## conf/distro/tuxable.conf
```bitbake
DISTRO_NAME = "Tuxable OE"
DISTRO_VERSION = "2020.04 Dunfell"
SDK_VENDOR = "-tuxable"
SDK_VERSION := "${DISTRO_VERSION}"

TOOLCHAIN_OUTPUTNAME = "${SDK_NAME}-${IMAGE_NAME}-toolchain-${SDK_VERSION}"
TOOLCHAIN_HOST_TASK_append += ""

DISTRO_FEATURES_TUXABLE = "ext2 usbhost wifi bluetooth"

DISTRO_FEATURES = "${DISTRO_FEATURES_TUXABLE} ${DISTRO_FEATURES_LIBC_DEFAULT}"

PREFERRED_PROVIDER_jpeg = "libjpeg-turbo"
PREFERRED_PROVIDER_jpeg-native = "libjpeg-turbo-native"

INIT_MANAGER = "systemd"

GLIBC_GENERATE_LOCALES = "en_GB.UTF-8 en_US.UTF-8"
```

## conf/layer.conf
```bitbake
BBPATH .= ":${LAYERDIR}"

BBFILES += "${LAYERDIR}/recipes-*/*/*.bb \
            ${LAYERDIR}/recipes-*/*/*.bbappend"

BBFILE_COLLECTIONS += "tuxable-distro"
BBFILE_PATTERN_tuxable-distro := "^${LAYERDIR}/"
BBFILE_PRIORITY_tuxable-distro = "6"

LAYERDEPENDS_tuxable-distro = "core"

LAYERSERIES_COMPAT_tuxable-distro = "gatesgarth"
```
